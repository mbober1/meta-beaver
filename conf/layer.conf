## conf/layer.conf
```bitbake
# We have a conf and classes directory, add to BBPATH
BBPATH .= ":${LAYERDIR}"

# We have recipes-* directories, add to BBFILES
BBFILES += "${LAYERDIR}/recipes-*/*/*.bb \
            ${LAYERDIR}/recipes-*/*/*.bbappend"

BBFILE_COLLECTIONS += "meta-beaver"
BBFILE_PATTERN_meta-beaver = "^${LAYERDIR}/"
BBFILE_PRIORITY_meta-beaver = "12"

LAYERDEPENDS_meta-beaver = "core swupdate"
LAYERSERIES_COMPAT_meta-beaver = "scarthgap styhead walnascar whinlatter"

BBFILES_DYNAMIC += " \
    meta-radxa:${LAYERDIR}/dynamic-layers/meta-radxa/*/*/*.bb \
    meta-radxa:${LAYERDIR}/dynamic-layers/meta-radxa/*/*/*.bbappend \
    chromium-browser-layer:${LAYERDIR}/dynamic-layers/chromium-browser-layer/*/*/*.bbappend \
"
```

## conf/machine/include/common.inc
```bitbake
KERNEL_DEVICETREE ??= " \
  ${CUSTOM_KERNEL_DEVICETREE} \
  ${KERNEL_DEVICETREE_OVERLAYS} \
  "
```

## conf/machine/include/rk3506.inc
```bitbake
SOC_FAMILY = "rk3506"

require conf/machine/include/soc-family.inc
require conf/machine/include/rockchip-defaults.inc
require conf/machine/include/arm/armv7a/tune-cortexa7.inc
require conf/machine/include/rockchip-wic.inc

KBUILD_DEFCONFIG ?= "defconfig"
KERNEL_CLASSES = "kernel-fitimage"
KERNEL_IMAGETYPE ?= "fitImage"

PREFERRED_PROVIDER_trusted-firmware-a = "rockchip-rkbin-tf-a"
PREFERRED_PROVIDER_optee-os = "rockchip-rkbin-optee-os"

UBOOT_SUFFIX ?= "itb"
UBOOT_ENTRYPOINT ?= "0x06000000"

TFA_PLATFORM = "rk3506"
TFA_BUILD_TARGET = "bl31"


PREFERRED_PROVIDER_virtual/bootloader ?= "u-boot"
PREFERRED_PROVIDER_virtual/kernel ?= "linux-rockchip"
KBUILD_DEFCONFIG ?= "rockchip_linux_defconfig"
MACHINEOVERRIDES .= ":rockchip"
```

## conf/machine/luckfox-lyra.conf
```bitbake
#@TYPE: Machine
#@NAME: Luckfox Lyra
#@DESCRIPTION: Luckfox Lyra
#https://www.luckfox.com/Luckfox-Lyra-Plus

require conf/machine/include/common.inc
require conf/machine/include/rk3506.inc

PREFERRED_PROVIDER_virtual/kernel = "linux-torvalds-next"
MACHINE_EXTRA_RRECOMMENDS += "kernel-modules"

UBOOT_MACHINE = "rk3506_defconfig"

#TODO: CUSTOM_KERNEL_DEVICETREE = "rockchip/rk3566-radxa-zero-3e.dtb"

IMAGE_FSTYPES = "wic wic.zst tar.zst"
WKS_FILE = "mini_partitions.wks.in"

UBOOT_EXTLINUX_KERNEL_ARGS = "rootwait rw"
UBOOT_EXTLINUX_ROOT = "root=/dev/mmcblk0p${bootpart}"
```

## conf/machine/radxa-zero-3e-custom.conf
```bitbake
#@TYPE: Machine
#@NAME: Radxa Zero 3E Custom
#@DESCRIPTION: Custom machine for Radxa Zero 3E
#http://radxa.com/products/zeros/zero3e/

require conf/machine/include/common.inc
require conf/machine/include/radxa-zero-3.inc
CUSTOM_KERNEL_DEVICETREE = "rockchip/rk3566-radxa-zero-3e.dtb"

IMAGE_FSTYPES = "wic wic.zst tar.zst"
WKS_FILE = "ota_partitions.wks.in"

UBOOT_EXTLINUX_KERNEL_ARGS = "rootwait rw rootfstype=ext4 quiet"
UBOOT_EXTLINUX_ROOT = "root=/dev/mmcblk0p${bootpart}"

MACHINE_FEATURES:append = " usbgadget usbhost rtc serial"
MACHINE_FEATURES:remove = "acpi pci wifi bluetooth qemu-usermode splash screen"
```

## conf/machine/rock-5b-plus.conf
```bitbake
#@TYPE: Machine
#@NAME: Radxa Rock 5B+
#@DESCRIPTION: ROCK5+ is the 5th generation of SBC designed by Radxa.
#https://radxa.com/products/rock5/5bp

require conf/machine/include/common.inc
require conf/machine/include/rk3588.inc

CUSTOM_KERNEL_DEVICETREE ?= "rockchip/rk3588-rock-5b-plus.dtb"
MACHINE_EXTRA_RRECOMMENDS += "kernel-modules"

UBOOT_MACHINE = "rock5b-rk3588_defconfig"

PREFERRED_PROVIDER_virtual/kernel = "linux-collabora"

IMAGE_FSTYPES = "wic wic.zst tar.zst"
WKS_FILE = "mini_partitions.wks.in"

UBOOT_EXTLINUX_KERNEL_ARGS += "rootwait rw rootfstype=ext4"
UBOOT_EXTLINUX_ROOT = "root=/dev/mmcblk1p${bootpart}"
```
