## conf/distro/beaveros.conf
```bitbake
DISTRO = "beaveros"
DISTRO_NAME = "BeaverOS"
DISTRO_VERSION = ""
DISTRO_CODENAME = ""

MAINTAINER = "Marcin Bober <mbober1@gmail.com>"

DEBUG_FEATURES ?= "debuginfod"

CUSTOM_DISTRO_FEATURES = " \
  acl \
  ipv4 \
  ipv6 \
  overlayfs \
  pam \
  pci \
  pni-names \
  seccomp \
  systemd \
  systemd-resolved \
  usbhost \
  usrmerge \
  vfat \
  xattr \
"

DISTRO_FEATURES ?= "${DEBUG_FEATURES} ${CUSTOM_DISTRO_FEATURES}"

DISTRO_EXTRA_RDEPENDS += " packagegroup-core-boot"
DISTRO_EXTRA_RRECOMMENDS += " kernel-module-af-packet"

TOOLCHAIN = "clang"
LLVM_LINKER = "lld"
RUNTIME = "llvm"

PACKAGE_CLASSES ?= "package_ipk"

INIT_MANAGER = "systemd"
VIRTUAL-RUNTIME_init_manager = "systemd"
VIRTUAL-RUNTIME_initscripts = "systemd-compat-units"
LICENSE_FLAGS_ACCEPTED = "commercial"
```
